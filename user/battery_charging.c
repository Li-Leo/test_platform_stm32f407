#include "log.h"
#include "FreeRTOS.h"
#include "cmsis_os.h"

const unsigned char battery_outline []  = {
		0xfc, 0xfe, 0x7, 0x3, 0x3, 0x3, 0x3, 0x3, 0x3, 0x3, 0x3, 0x3,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 0x0,
		0xff, 0xff, 0x0, 0x0, 0x0, 0x0, 0x0, 0x0, 0x0, 0x0, 0x0, 0x0,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 0xe0,
		0xff, 0xff, 0x0, 0x0, 0x0, 0x0, 0x0, 0x0, 0x0, 0x0, 0x0, 0x0,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 0xff,
		0xff, 0xff, 0x0, 0x0, 0x0, 0x0, 0x0, 0x0, 0x0, 0x0, 0x0, 0x0,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 0x7,
		0x3f, 0x7f, 0xe0, 0xc0, 0xc0, 0xc0, 0xc0, 0xc0, 0xc0, 0xc0, 0xc0, 0xc0,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 0x0,
};


const unsigned char water_array[30][128] = {
		0xfe, 0x0, 0x0, 0x0, 0x0, 0x0, 0x0, 0x0, 0x0, 0x0, 0x0, 0x0, 0x0, 0x0, 0x0, 0x0, 0x0, 0x0, 0x0, 0x0, 0x0, 0x0, 0x0, 0x0, 0x0, 0x0, 0x0, 0x0, 0x0, 0x0, 0x0, 0x0,
		0xff, 0x0, 0x0, 0x0, 0x0, 0x0, 0x0, 0x0, 0x0, 0x0, 0x0, 0x0, 0x0, 0x0, 0x0, 0x0, 0x0, 0x0, 0x0, 0x0, 0x0, 0x0, 0x0, 0x0, 0x0, 0x0, 0x0, 0x0, 0x0, 0x0, 0x0, 0x0,
		0xff, 0xfe, 0xfc, 0xf8, 0xf0, 0xf0, 0xe0, 0xc0, 0xc0, 0x0, 0x0, 0x0, 0x0, 0x0, 0x0, 0xc, 0x1e, 0x1e, 0x1e, 0x1c, 0x0, 0x0, 0x0, 0x0, 0x0, 0x0, 0x0, 0x0, 0x0, 0x0, 0x0, 0x0,
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		0xff, 0xff, 0xff, 0xff, 0x7f, 0x7f, 0x3f, 0x3f, 0x1f, 0x1f, 0xf, 0x0, 0x0, 0x0, 0x0, 0x0, 0x0, 0x0, 0x0, 0x0, 0x0, 0x0, 0x0, 0x0, 0x0, 0x3, 0x7, 0x2, 0x0, 0x0, 0x0, 0x0,


};

const unsigned char custom_num_12X16[10][24] = {
0x0, 0xe0, 0xf0, 0x38, 0x8, 0x0, 0x8, 0x18, 0x18, 0xf0, 0xe0, 0x80,
0x0, 0xf, 0x1f, 0x18, 0x10, 0x30, 0x30, 0x10, 0x10, 0x1f, 0x7, 0x3,

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0x0, 0x0, 0x0, 0x0, 0x70, 0xff, 0xff, 0x87, 0x0, 0x0, 0x0, 0x0,
};



long map(long x, long in_min, long in_max, long out_min, long out_max) {
  return (x - in_min) * (out_max - out_min) / (in_max - in_min) + out_min;
}

void OLED_ShowCustomNum(int16_t X, int16_t Y, int n)
{
	if (n < 10)
	{
		OLED_ShowImage(X, Y, 12, 16, custom_num_12X16[n]);
	}
	else if (n >= 10 && n < 100)
	{
		OLED_ShowImage(X-12, Y, 12, 16, custom_num_12X16[n/10]);
		OLED_ShowImage(X, Y, 12, 16, custom_num_12X16[n%10]);
	}
	else if (n < 999)
	{
		OLED_ShowImage(X-24, Y, 12, 16, custom_num_12X16[n/100]);
		OLED_ShowImage(X-12, Y, 12, 16, custom_num_12X16[n/10%10]);
		OLED_ShowImage(X, Y, 12, 16, custom_num_12X16[n%10]);
	}
}

#define MODE 2  // range: 0, 1, 2

int battery_charging(void)
{
    /* USER CODE BEGIN 1 */
        int battery_fill_perc = 0; // battery fill percentage 0-100%
        int anim_frame = 0; // animation frame for the blob / metaballs animation

        int xoff = 29;//0;//29;   // x offset for the battery
        int yoff = 12;//0;//24;   // y offset for the battery
    /* USER CODE END 1 */

    int num_pos_x = 64;

    #if MODE == 0
    xoff = 29;
    yoff = 0;
    int real_battery_fill_perc = 0;
    while(1) {
        if (battery_fill_perc == 0) {
            OLED_ShowImage(xoff, yoff, 70, 40, battery_outline);
            OLED_Update();
        }
        int fill_width = map(battery_fill_perc, 0, 100, 4, 61); // width of the fill rectangle
        OLED_DrawRectangle(xoff+3, yoff+3, fill_width, 34, 1);

        OLED_ShowImage(xoff + 3 + fill_width - 1, yoff+3, 32, 32, water_array[anim_frame]); // draw blob animation
        OLED_UpdateArea(xoff, yoff, 64, 40);// restrict all graphics output to the specified range

        OLED_ShowCustomNum(num_pos_x, 48, real_battery_fill_perc);
        OLED_ShowChar(num_pos_x+12, 48, '%', OLED_6X8);

        OLED_UpdateArea(num_pos_x - 24, 48, 42, 16);

        // increase battery fill percentage 0-100
        battery_fill_perc++;
        if (battery_fill_perc > 100) {
            battery_fill_perc = 0;
            real_battery_fill_perc ++;
            OLED_Clear();

        }
        if (real_battery_fill_perc > 100) {
            battery_fill_perc = 0;
            real_battery_fill_perc = 0;
            OLED_Clear();
            HAL_Delay(5000);
        }
        // current frame for the blob animation, 0-29
        anim_frame = (anim_frame + 1) % 30;
    //	  HAL_Delay(100);
    }

    #elif MODE == 1
    xoff = 29;
    yoff = 0;
    while(1) {
        if (battery_fill_perc == 0) {
            OLED_ShowImage(xoff, yoff, 70, 40, battery_outline);
            OLED_Update();
        }
        int fill_width = map(battery_fill_perc, 0, 100, 4, 61); // width of the fill rectangle
        OLED_DrawRectangle(xoff+3, yoff+3, fill_width, 34, 1);

        OLED_ShowImage(xoff + 3 + fill_width - 1, yoff+3, 32, 32, water_array[anim_frame]); // draw blob animation
        OLED_UpdateArea(xoff, yoff, 64, 40);// restrict all graphics output to the specified range

        OLED_ShowCustomNum(num_pos_x, 48, battery_fill_perc);
        OLED_ShowChar(num_pos_x+12, 48, '%', OLED_6X8);
        OLED_UpdateArea(num_pos_x - 24, 48, 42, 16);

        // increase battery fill percentage 0-100
        battery_fill_perc++;
        if (battery_fill_perc > 100) {
            battery_fill_perc = 0;
            OLED_Clear();
            HAL_Delay(5000);
        }

        // current frame for the blob animation, 0-29
        anim_frame = (anim_frame + 1) % 30;
        HAL_Delay(100);
    }
    #else
    xoff = 29;//0;//29;   // x offset for the battery
    yoff = 12;//0;//24;   // y offset for the battery
    while (1)
    {
        if (battery_fill_perc == 0) {
            OLED_ShowImage(xoff, yoff, 70, 40, battery_outline);
            OLED_Update();
        }
        int fill_width = map(battery_fill_perc, 0, 100, 4, 61); // width of the fill rectangle
        OLED_DrawRectangle(xoff+3, yoff+3, fill_width, 34, 1);

        OLED_ShowImage(xoff + 3 + fill_width - 1, yoff+3, 32, 32, water_array[anim_frame]); // draw blob animation
        OLED_UpdateArea(xoff, yoff, 64, 40);// restrict all graphics output to the specified range


        // increase battery fill percentage 0-100
        battery_fill_perc++;
        if (battery_fill_perc > 100) {
            battery_fill_perc = 0;
            OLED_Clear();
        }

        // current frame for the blob animation, 0-29
        anim_frame = (anim_frame + 1) % 30;
        /* USER CODE END WHILE */

        /* USER CODE BEGIN 3 */
    }
    #endif
}

osThreadId_t battery_charging_handle;
const osThreadAttr_t battery_charging_attributes = {
    .name = "charging",
    .stack_size = 128 * 4,
    .priority = (osPriority_t) osPriorityNormal,
};

void battery(void *argument)
{

    int battery_fill_perc = 0; // battery fill percentage 0-100%
    int anim_frame = 0; // animation frame for the blob / metaballs animation
    // int num_pos_x = 64;
    int xoff = 29;//0;//29;   // x offset for the battery
    int yoff = 12;//0;//24;   // y offset for the battery
    int fill_width;

    while (1) {
        if (battery_fill_perc == 0) {
            OLED_ShowImage(xoff, yoff, 70, 40, battery_outline);
            OLED_Update();
        }

        fill_width = map(battery_fill_perc, 0, 100, 4, 61); // width of the fill rectangle
        OLED_DrawRectangle(xoff+3, yoff+3, fill_width, 34, 1);

        OLED_ShowImage(xoff + 3 + fill_width - 1, yoff+3, 32, 32, water_array[anim_frame]); // draw blob animation
        OLED_UpdateArea(xoff, yoff, 64, 40);// restrict all graphics output to the specified range


        // increase battery fill percentage 0-100
        battery_fill_perc++;
        if (battery_fill_perc > 100) {
            battery_fill_perc = 0;
            OLED_Clear();
        }

        // current frame for the blob animation, 0-29
        anim_frame = (anim_frame + 1) % 30;
        osDelay(20);
        /* USER CODE END WHILE */

        /* USER CODE BEGIN 3 */
    }
}


void start_charnging(void)
{
    battery_charging_handle = osThreadNew(battery, NULL, &battery_charging_attributes);
}

SHELL_EXPORT_CMD(SHELL_CMD_PERMISSION(0)|SHELL_CMD_TYPE(SHELL_TYPE_CMD_FUNC), battery_charging, battery_charging, battery_charging);
SHELL_EXPORT_CMD(SHELL_CMD_PERMISSION(0)|SHELL_CMD_TYPE(SHELL_TYPE_CMD_FUNC), start_charnging, start_charnging, start_charnging);

